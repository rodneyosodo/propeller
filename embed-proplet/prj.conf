## CMakeLists.txt
```
cmake_minimum_required(VERSION 3.20.0)

set(BOARD esp32s3_devkitc)

find_package(Zephyr REQUIRED HINTS $ENV{ZEPHYR_BASE})
project(proplet_mqtt_client)

set(WAMR_BUILD_PLATFORM "zephyr")
set(WAMR_BUILD_TARGET "XTENSA")

if (NOT DEFINED WAMR_BUILD_INTERP)
  set(WAMR_BUILD_INTERP 1)
endif ()

if (NOT DEFINED WAMR_BUILD_AOT)
  set(WAMR_BUILD_AOT 1)
endif ()

if (NOT DEFINED WAMR_BUILD_LIBC_BUILTIN)
  set(WAMR_BUILD_LIBC_BUILTIN 1)
endif ()

# Disable libc wasi support by default. In the future,
# it can be enabled if libc wasi file/socket/lock support is ready on Zephyr platform
if (NOT DEFINED WAMR_BUILD_LIBC_WASI)
  set(WAMR_BUILD_LIBC_WASI 0)
endif ()

set(WAMR_BUILD_GLOBAL_HEAP_POOL 1)
if (NOT DEFINED WAMR_BUILD_GLOBAL_HEAP_SIZE)
  set(WAMR_BUILD_GLOBAL_HEAP_SIZE 40960)
endif ()

set(WAMR_ROOT_DIR ${CMAKE_CURRENT_SOURCE_DIR}/modules/wamr/wasm-micro-runtime)
include(${WAMR_ROOT_DIR}/build-scripts/runtime_lib.cmake)

list(APPEND ZEPHYR_EXTRA_MODULES ${WAMR_ROOT_DIR}/product-mini/platforms/zephyr)

include_directories(${ZEPHYR_BASE}/include/zephyr)

target_include_directories(app PRIVATE
    ${WAMR_ROOT_DIR}/core/iwasm/include
)

# Embed WAMR as a Zephyr library
zephyr_library_named(wamr_lib)

zephyr_library_sources(${WAMR_RUNTIME_LIB_SOURCE})

zephyr_library_app_memory(wamr_partition)

target_sources(app PRIVATE src/cJSON.c src/credentials.c src/main.c src/mqtt_client.c src/task_monitor.c src/wasm_handler.c src/wifi_manager.c)

target_link_libraries(app PRIVATE wamr_lib)
```

## prj.conf
```kconfig
# General Networking
CONFIG_WIFI=y
CONFIG_WIFI_NM=y
CONFIG_NET_MGMT=y
CONFIG_NETWORKING=y
CONFIG_NET_CONFIG_AUTO_INIT=n
CONFIG_NET_MGMT_EVENT=y
CONFIG_NET_MGMT_EVENT_INFO=y
CONFIG_NET_MGMT_EVENT_QUEUE_SIZE=10
CONFIG_NET_MGMT_EVENT_STACK_SIZE=4096
CONFIG_NET_MGMT_EVENT_QUEUE_TIMEOUT=5000

# Protocols
CONFIG_NET_DHCPV4=y
CONFIG_NET_DHCPV4_SERVER=y
CONFIG_NET_IPV4=y
# Uncomment to enable IPv6
# CONFIG_NET_IPV6=y
CONFIG_NET_TCP=y
CONFIG_NET_UDP=y

# Interface Configuration
CONFIG_NET_IF_MAX_IPV4_COUNT=2
# required only if NET_IPV6 is set
# CONFIG_NET_IF_MAX_IPV6_COUNT=2
CONFIG_NET_L2_ETHERNET=y
CONFIG_NET_L2_WIFI_MGMT=y
CONFIG_WIFI_NM_MAX_MANAGED_INTERFACES=2

# Buffer and Packet Management
CONFIG_NET_BUF_RX_COUNT=64
CONFIG_NET_BUF_TX_COUNT=64
CONFIG_NET_BUF_DATA_SIZE=256
CONFIG_NET_PKT_RX_COUNT=32
CONFIG_NET_PKT_TX_COUNT=32
CONFIG_NET_RX_STACK_SIZE=2048
CONFIG_NET_TX_STACK_SIZE=2048
CONFIG_NET_MAX_CONTEXTS=10

# MQTT Client
CONFIG_MQTT_LIB=y
# Enable Sockets (used by MQTT lib and HTTP client)
CONFIG_NET_SOCKETS=y
# HTTP Client support
CONFIG_HTTP_CLIENT=y

# Enable TLS support for socket MQTT Library.
CONFIG_MQTT_LIB_TLS=y
CONFIG_NET_SOCKETS_TLS=y
CONFIG_MQTT_KEEPALIVE=30
CONFIG_MQTT_CLEAN_SESSION=n
CONFIG_MQTT_LIB_WEBSOCKET=n
# Enable ALPN protocol for socket MQTT Library (needed for TLS MQTT).
CONFIG_MQTT_LIB_TLS_USE_ALPN=y

# JSON Parsing
# CONFIG_JSON_LIBRARY=y
# Note: Zephyr's JSON library has been replaced by cJSON for JSON parsing and encoding.
# Uncomment the line above only if reverting to the Zephyr JSON library is necessary.

# Logging
CONFIG_LOG=y
CONFIG_LOG_DEFAULT_LEVEL=3
CONFIG_LOG_BUFFER_SIZE=4096
CONFIG_LOG_MODE_DEFERRED=n
# Uncomment to enable debug logs for mqtt, networking stack, Wi-Fi operations, and DHCPv4 server component.
# CONFIG_MQTT_LOG_LEVEL_DBG=y
# CONFIG_NET_LOG=y
# CONFIG_WIFI_LOG_LEVEL_DBG=y
# CONFIG_NET_DHCPV4_SERVER_LOG_LEVEL_DBG=y

# Debugging and Early Boot
CONFIG_EARLY_CONSOLE=y
CONFIG_INIT_STACKS=y
CONFIG_STACK_SENTINEL=y

# Statistics and Diagnostics
CONFIG_NET_STATISTICS=y
CONFIG_NET_STATISTICS_PERIODIC_OUTPUT=n

# Thread Analyzer
# Uncomment to debug thread-related issues.
# CONFIG_THREAD_NAME=y
# CONFIG_THREAD_ANALYZER=y
# CONFIG_THREAD_ANALYZER_AUTO=y
# CONFIG_THREAD_ANALYZER_AUTO_INTERVAL=5
# CONFIG_THREAD_ANALYZER_LOG_LEVEL_DBG=y
# CONFIG_THREAD_ANALYZER_ISR_STACK_USAGE=y

# Flash and NVS-backed settings
CONFIG_FLASH=y
CONFIG_FLASH_PAGE_LAYOUT=y
CONFIG_FLASH_MAP=y
CONFIG_NVS=y
CONFIG_SETTINGS=y
CONFIG_SETTINGS_NVS=y

# Miscellaneous
CONFIG_BASE64=y
CONFIG_MAIN_STACK_SIZE=8192
CONFIG_IDLE_STACK_SIZE=2048
CONFIG_LOG_PROCESS_THREAD_STACK_SIZE=4096
CONFIG_DYNAMIC_THREAD_STACK_SIZE=4096
CONFIG_SYSTEM_WORKQUEUE_STACK_SIZE=4096
CONFIG_NET_SOCKETS_SERVICE_STACK_SIZE=4096
CONFIG_HEAP_MEM_POOL_SIZE=65536

# Metrics support
CONFIG_SYS_HEAP_RUNTIME_STATS=y
CONFIG_THREAD_MONITOR=y
# CONFIG_CPU_LOAD is not supported on Xtensa targets
```

## src/main.c
```c
#include "credentials.h"
#include "mqtt_client.h"
#include "task_monitor.h"
#include "wifi_manager.h"
#include <zephyr/kernel.h>
#include <zephyr/logging/log.h>

LOG_MODULE_REGISTER(main);

#define PROPLET_NAMESPACE "embedded"

#define PROPLET_DESCRIPTION "ESP32-S3 embed-proplet"
#define PROPLET_TAGS "embedded,esp32s3,zephyr"
#define PROPLET_LOCATION "dev-bench"
#define PROPLET_VERSION "0.1.0-PROP-103"

#ifndef PROPLET_LIVELINESS_INTERVAL_MS
#define PROPLET_LIVELINESS_INTERVAL_MS 10000
#endif

#ifndef PROPLET_METRICS_INTERVAL_MS
#define PROPLET_METRICS_INTERVAL_MS 30000
#endif

#ifndef PROPLET_TASK_METRICS_INTERVAL_MS
#define PROPLET_TASK_METRICS_INTERVAL_MS 10000
#endif

static const struct proplet_credentials defaults = {
    .wifi_ssid = "<YOUR_WIFI_SSID>",
    .wifi_psk = "<YOUR_WIFI_PSK>",
    .proplet_id = "<YOUR_PROPLET_ID>",
    .api_key = "<YOUR_API_KEY>",
    .tenant_id = "<YOUR_TENANT_ID>",
    .channel_id = "<YOUR_CHANNEL_ID>",
    .mqtt_broker_host = "10.42.0.1",
    .mqtt_broker_port = 1883,
    .mqtt_tls_enabled = false,
    .tls_client_cert = "",
    .tls_client_key = "",
};

int main(void) {
  LOG_INF("Starting Proplet...");

  struct proplet_credentials creds;

  if (credentials_load(&creds, &defaults) != 0) {
    LOG_ERR("Failed to load credentials");
    return -1;
  }

  wifi_manager_init();
  wifi_manager_connect(creds.wifi_ssid, creds.wifi_psk);

  if (task_monitor_init() != 0) {
    LOG_WRN("Task monitor init failed, metrics may be unavailable");
  }

  if (mqtt_client_connect(creds.tenant_id, creds.proplet_id, creds.api_key,
                          creds.channel_id) != 0) {
    LOG_ERR("MQTT connect failed");
    return -1;
  }

  if (subscribe(creds.tenant_id, creds.channel_id) != 0) {
    LOG_ERR("MQTT subscribe failed");
    return -1;
  }

  if (publish_discovery(creds.tenant_id, creds.proplet_id, creds.channel_id,
                        PROPLET_DESCRIPTION, PROPLET_TAGS, PROPLET_LOCATION,
                        PROPLET_VERSION) != 0) {
    LOG_ERR("MQTT discovery publish failed");
    return -1;
  }

  for (int i = 0; i < 20; i++) {
    mqtt_client_process();
    k_sleep(K_MSEC(100));
  }

  int64_t next_alive = k_uptime_get() + PROPLET_LIVELINESS_INTERVAL_MS;
  int64_t next_metrics = k_uptime_get() + PROPLET_METRICS_INTERVAL_MS;
  int64_t next_task_metrics = k_uptime_get() + PROPLET_TASK_METRICS_INTERVAL_MS;

  while (1) {
    mqtt_client_process();

    int64_t now = k_uptime_get();

    if (now >= next_alive) {
      publish_alive_message(creds.tenant_id, creds.channel_id);
      next_alive = now + PROPLET_LIVELINESS_INTERVAL_MS;
    }

    if (now >= next_metrics) {
      publish_metrics_message(creds.tenant_id, creds.channel_id,
                              creds.proplet_id, PROPLET_NAMESPACE);
      next_metrics = now + PROPLET_METRICS_INTERVAL_MS;
    }

    if (now >= next_task_metrics) {
      publish_active_task_metrics(creds.tenant_id, creds.channel_id,
                                  creds.proplet_id);
      next_task_metrics = now + PROPLET_TASK_METRICS_INTERVAL_MS;
    }

    k_sleep(K_MSEC(200));
  }
}
```

## src/credentials.c
```c
#include "credentials.h"

#include <stdlib.h>
#include <string.h>
#include <zephyr/logging/log.h>
#include <zephyr/settings/settings.h>

LOG_MODULE_REGISTER(credentials);

static struct proplet_credentials *g_creds;

static int creds_set_cb(const char *key, size_t len, settings_read_cb read_cb,
                        void *cb_arg) {
  if (!g_creds) {
    return -EINVAL;
  }

  if (strcmp(key, "wifi_ssid") == 0) {
    size_t max = CRED_MAX_LEN - 1;
    ssize_t rc = read_cb(cb_arg, g_creds->wifi_ssid, MIN(len, max));
    if (rc < 0)
      return (int)rc;
    g_creds->wifi_ssid[rc] = '\0';
  } else if (strcmp(key, "wifi_psk") == 0) {
    size_t max = CRED_MAX_LEN - 1;
    ssize_t rc = read_cb(cb_arg, g_creds->wifi_psk, MIN(len, max));
    if (rc < 0)
      return (int)rc;
    g_creds->wifi_psk[rc] = '\0';
  } else if (strcmp(key, "proplet_id") == 0) {
    size_t max = CRED_MAX_LEN - 1;
    ssize_t rc = read_cb(cb_arg, g_creds->proplet_id, MIN(len, max));
    if (rc < 0)
      return (int)rc;
    g_creds->proplet_id[rc] = '\0';
  } else if (strcmp(key, "api_key") == 0) {
    size_t max = CRED_MAX_LEN - 1;
    ssize_t rc = read_cb(cb_arg, g_creds->api_key, MIN(len, max));
    if (rc < 0)
      return (int)rc;
    g_creds->api_key[rc] = '\0';
  } else if (strcmp(key, "tenant_id") == 0) {
    size_t max = CRED_MAX_LEN - 1;
    ssize_t rc = read_cb(cb_arg, g_creds->tenant_id, MIN(len, max));
    if (rc < 0)
      return (int)rc;
    g_creds->tenant_id[rc] = '\0';
  } else if (strcmp(key, "channel_id") == 0) {
    size_t max = CRED_MAX_LEN - 1;
    ssize_t rc = read_cb(cb_arg, g_creds->channel_id, MIN(len, max));
    if (rc < 0)
      return (int)rc;
    g_creds->channel_id[rc] = '\0';
  } else if (strcmp(key, "mqtt_broker_host") == 0) {
    size_t max = CRED_HOST_LEN - 1;
    ssize_t rc = read_cb(cb_arg, g_creds->mqtt_broker_host, MIN(len, max));
    if (rc < 0)
      return (int)rc;
    g_creds->mqtt_broker_host[rc] = '\0';
  } else if (strcmp(key, "mqtt_broker_port") == 0) {
    char buf[8];
    ssize_t rc = read_cb(cb_arg, buf, MIN(len, sizeof(buf) - 1));
    if (rc < 0)
      return (int)rc;
    buf[rc] = '\0';
    g_creds->mqtt_broker_port = (uint16_t)strtoul(buf, NULL, 10);
  } else if (strcmp(key, "mqtt_tls_enabled") == 0) {
    char buf[2];
    ssize_t rc = read_cb(cb_arg, buf, MIN(len, sizeof(buf) - 1));
    if (rc < 0)
      return (int)rc;
    buf[rc] = '\0';
    g_creds->mqtt_tls_enabled =
        (buf[0] == '1' || buf[0] == 't' || buf[0] == 'T');
  } else if (strcmp(key, "tls_client_cert") == 0) {
    size_t max = CRED_CERT_LEN - 1;
    ssize_t rc = read_cb(cb_arg, g_creds->tls_client_cert, MIN(len, max));
    if (rc < 0)
      return (int)rc;
    g_creds->tls_client_cert[rc] = '\0';
  } else if (strcmp(key, "tls_client_key") == 0) {
    size_t max = CRED_CERT_LEN - 1;
    ssize_t rc = read_cb(cb_arg, g_creds->tls_client_key, MIN(len, max));
    if (rc < 0)
      return (int)rc;
    g_creds->tls_client_key[rc] = '\0';
  } else {
    return -ENOENT;
  }

  return 0;
}

static struct settings_handler creds_handler = {
    .name = "proplet",
    .h_set = creds_set_cb,
};

int credentials_load(struct proplet_credentials *creds,
                     const struct proplet_credentials *defaults) {
  g_creds = creds;
  memcpy(creds, defaults, sizeof(*creds));

  int rc = settings_subsys_init();

  if (rc) {
    LOG_ERR("settings_subsys_init failed: %d", rc);
    return rc;
  }

  rc = settings_register(&creds_handler);
  if (rc) {
    LOG_ERR("settings_register failed: %d", rc);
    return rc;
  }

  rc = settings_load_subtree("proplet");
  if (rc) {
    LOG_WRN("settings_load failed: %d (using defaults)", rc);
  }

  return 0;
}

const struct proplet_credentials *credentials_get(void) { return g_creds; }
```

## src/credentials.h
```c
#ifndef CREDENTIALS_H
#define CREDENTIALS_H

#include <stdbool.h>
#include <stdint.h>

#define CRED_MAX_LEN 64
#define CRED_HOST_LEN 128
#define CRED_CERT_LEN 2048

struct proplet_credentials {
  char wifi_ssid[CRED_MAX_LEN];
  char wifi_psk[CRED_MAX_LEN];
  char proplet_id[CRED_MAX_LEN];
  char api_key[CRED_MAX_LEN];
  char tenant_id[CRED_MAX_LEN];
  char channel_id[CRED_MAX_LEN];
  char mqtt_broker_host[CRED_HOST_LEN];
  uint16_t mqtt_broker_port;
  bool mqtt_tls_enabled;
  char tls_client_cert[CRED_CERT_LEN];
  char tls_client_key[CRED_CERT_LEN];
};

int credentials_load(struct proplet_credentials *creds,
                     const struct proplet_credentials *defaults);

const struct proplet_credentials *credentials_get(void);

#endif /* CREDENTIALS_H */
```

## src/mqtt_client.h
```c
#ifndef MQTT_CLIENT_H
#define MQTT_CLIENT_H

#include <stdbool.h>
#include <stddef.h>
#include <stdint.h>
#include <zephyr/net/mqtt.h>

#define PAYLOAD_BUFFER_SIZE 1024

/* Default MQTT broker settings */
#define MQTT_BROKER_HOSTNAME "10.42.0.1"
#define MQTT_BROKER_PORT 1883
#define MQTT_BROKER_PORT_TLS 8883

#define MAX_ID_LEN 64
#define MAX_NAME_LEN 64
#define MAX_STATE_LEN 16
#define MAX_URL_LEN 256
#define MAX_TIMESTAMP_LEN 32
#define MAX_BASE64_LEN 1024
#define MAX_INPUTS 16
#define MAX_RESULTS 16

struct task {
  char id[MAX_ID_LEN];
  char name[MAX_NAME_LEN];
  char state[MAX_STATE_LEN];
  char image_url[MAX_URL_LEN];
  char mode[MAX_NAME_LEN];

  char file[MAX_BASE64_LEN];
  size_t file_len;

  uint64_t inputs[MAX_INPUTS];
  size_t inputs_count;
  uint64_t results[MAX_RESULTS];
  size_t results_count;

  char start_time[MAX_TIMESTAMP_LEN];
  char finish_time[MAX_TIMESTAMP_LEN];
  char created_at[MAX_TIMESTAMP_LEN];
  char updated_at[MAX_TIMESTAMP_LEN];

  bool is_fl_task;

  char fl_round_id_str[32];
  char fl_format[MAX_NAME_LEN];
  char fl_num_samples_str[32];

  char round_id[MAX_ID_LEN];
  char model_uri[MAX_URL_LEN];
  char hyperparams[512];
  bool is_fml_task;

  char proplet_id[MAX_ID_LEN];
  char model_data[4096];
  char dataset_data[4096];
  char coordinator_url[MAX_URL_LEN];
  char model_registry_url[MAX_URL_LEN];
  char data_store_url[MAX_URL_LEN];
  bool model_data_fetched;
  bool dataset_data_fetched;
};

extern struct task g_current_task;

extern bool mqtt_connected;

/**
 * @brief Initialize the MQTT client and establish a connection to the broker.
 *
 * Connects using proplet_id as MQTT client ID and username, client_key as
 * password.
 *
 * @param tenant_id   Tenant ID used for topic generation (e.g.,
 * m/<tenant>/c/<channel>/...).
 * @param proplet_id  Proplet identity (Propeller entity_id) — used as MQTT
 * username.
 * @param api_key     Propeller Entity secret — used as MQTT password.
 * @param channel_id  Channel ID used for topic generation.
 *
 * @return 0 on success, negative errno on failure.
 */
int mqtt_client_connect(const char *tenant_id, const char *proplet_id,
                        const char *api_key, const char *channel_id);

/**
 * @brief Subscribe to the manager/control topics for a channel.
 *
 * @param tenant_id  Tenant ID used for topic generation.
 * @param channel_id Channel ID used for topic generation.
 *
 * @return 0 on success, negative errno on failure.
 */
int subscribe(const char *tenant_id, const char *channel_id);

/**
 * @brief Publish a message to a specific MQTT topic.
 *
 * @param tenant_id       Tenant ID used for topic generation.
 * @param channel_id      Channel ID used for topic generation.
 * @param topic_template  Topic template string that accepts (tenant_id,
 * channel_id).
 * @param payload         Null-terminated JSON payload string.
 *
 * @return 0 on success, negative errno on failure.
 */
int publish(const char *tenant_id, const char *channel_id,
            const char *topic_template, const char *payload);

/**
 * @brief Publish a periodic "alive" message to notify the manager of
 * liveliness.
 *
 * Uses the proplet_id captured during mqtt_client_connect().
 *
 * @param tenant_id  Tenant ID used for topic generation.
 * @param channel_id Channel ID used for topic generation.
 */
void publish_alive_message(const char *tenant_id, const char *channel_id);

/**
 * @brief Publish periodic CPU/memory metrics.
 *
 * Payload shape: { proplet_id, namespace, metrics: {...} }
 *
 * @param tenant_id         Tenant ID used for topic generation.
 * @param channel_id        Channel ID used for topic generation.
 * @param proplet_id        Proplet identity.
 * @param k8s_namespace     Kubernetes namespace label (e.g. "embedded").
 */
void publish_metrics_message(const char *tenant_id, const char *channel_id,
                             const char *proplet_id, const char *k8s_namespace);

/**
 * @brief Publish a request to fetch a file from the registry.
 *
 * @param tenant_id  Tenant ID used for topic generation.
 * @param channel_id Channel ID used for topic generation.
 * @param app_name   Registry app name / image reference to fetch.
 */
void publish_registry_request(const char *tenant_id, const char *channel_id,
                              const char *app_name);

/**
 * @brief Publish a discovery message when the Proplet comes online.
 *
 * Auto-detected fields (ip, environment, os, hostname, cpu_arch,
 * total_memory_bytes, wasm_runtime) are resolved inside the function.
 *
 * @param tenant_id   Tenant ID used for topic generation.
 * @param proplet_id  Proplet identity.
 * @param channel_id  Channel ID used for topic generation.
 * @param description Human-readable description of this proplet (may be empty).
 * @param tags        Comma-separated tag list, e.g. "gateway,prod" (may be
 * empty).
 * @param location    Physical or logical location string (may be empty).
 * @param version     Firmware/software version string.
 *
 * @return 0 on success, negative errno on failure.
 */
int publish_discovery(const char *tenant_id, const char *proplet_id,
                      const char *channel_id, const char *description,
                      const char *tags, const char *location,
                      const char *version);

/**
 * @brief Publish the results of a completed task.
 *
 * @param tenant_id  Tenant ID used for topic generation.
 * @param channel_id Channel ID used for topic generation.
 * @param task_id    Task identifier.
 * @param results    Result string (will be JSON-escaped by caller if needed).
 */
void publish_results(const char *tenant_id, const char *channel_id,
                     const char *task_id, const char *results);

/**
 * @brief Publish the results of a completed task with optional error message.
 *
 * @param tenant_id  Tenant ID used for topic generation.
 * @param channel_id Channel ID used for topic generation.
 * @param task_id    Task identifier.
 * @param results    Result string (will be JSON-escaped by caller if needed).
 * @param error_msg  Optional error message (NULL if no error).
 */
void publish_results_with_error(const char *tenant_id, const char *channel_id,
                                const char *task_id, const char *results,
                                const char *error_msg);

/** @brief Publish task-level metrics for a specific task.
 *
 * Publishes CPU, memory, and timing metrics for a running or recently
 * completed WASM task.
 *
 * @param tenant_id   Tenant ID used for topic generation.
 * @param channel_id  Channel ID used for topic generation.
 * @param task_id     Task identifier being monitored.
 * @param proplet_id  Proplet identity.
 */
void publish_task_metrics(const char *tenant_id, const char *channel_id,
                          const char *task_id, const char *proplet_id);

/**
 * @brief Publish metrics for all active monitored tasks.
 *
 * Iterates through all currently monitored tasks and publishes their metrics.
 *
 * @param tenant_id   Tenant ID used for topic generation.
 * @param channel_id  Channel ID used for topic generation.
 * @param proplet_id  Proplet identity.
 */
void publish_active_task_metrics(const char *tenant_id, const char *channel_id,
                                 const char *proplet_id);

/**
 * @brief Process incoming MQTT messages and maintain keepalive.
 */
void mqtt_client_process(void);

/**
 * @brief Handle the start command received via MQTT.
 *
 * @param payload JSON payload for the start command.
 */
void handle_start_command(const char *payload);

/**
 * @brief Handle the stop command received via MQTT.
 *
 * @param payload JSON payload for the stop command.
 */
void handle_stop_command(const char *payload);

/**
 * @brief Handle registry response that contains the base64-encoded WASM.
 *
 * @param payload JSON payload containing app_name + data (base64).
 *
 * @return 0 on success, negative errno on failure.
 */
int handle_registry_response(const char *payload);

#endif /* MQTT_CLIENT_H */
```

## src/wasm_handler.c
```c
#include "wasm_handler.h"
#include "mqtt_client.h"
#include "task_monitor.h"
#include <logging/log.h>
#include <stdbool.h>
#include <string.h>
#include <wasm_export.h>

LOG_MODULE_REGISTER(wasm_handler);

#define MAX_WASM_APPS 10
#define MAX_ID_LEN 64
#define MAX_INPUTS 16
#define MAX_RESULTS 16

typedef struct {
  bool in_use;
  char id[MAX_ID_LEN];
  wasm_module_t module;
  wasm_module_inst_t module_inst;
} wasm_app_t;

static wasm_app_t g_wasm_apps[MAX_WASM_APPS];
static K_MUTEX_DEFINE(g_wasm_apps_mutex);

static bool g_wamr_initialized = false;

static void maybe_init_wamr_runtime(void);
static int find_free_slot(void);
static int find_app_by_id(const char *task_id);

static bool write_string_to_wasm_memory(wasm_exec_env_t exec_env,
                                        const char *str, uint32_t *ret_offset,
                                        uint32_t *ret_len) {
  wasm_module_inst_t module_inst = wasm_runtime_get_module_inst(exec_env);
  if (!module_inst || !str) {
    return false;
  }

  size_t str_len = strlen(str);
  uint32_t str_buf_offset =
      wasm_runtime_module_malloc(module_inst, str_len + 1, (void **)NULL);
  if (str_buf_offset == 0) {
    LOG_ERR("Failed to allocate WASM memory for string");
    return false;
  }

  char *str_buf = wasm_runtime_addr_app_to_native(module_inst, str_buf_offset);
  if (!str_buf) {
    wasm_runtime_module_free(module_inst, str_buf_offset);
    return false;
  }

  memcpy(str_buf, str, str_len + 1);
  *ret_offset = str_buf_offset;
  *ret_len = str_len;
  return true;
}

static bool get_proplet_id_wrapper(wasm_exec_env_t exec_env,
                                   uint32_t *ret_offset, uint32_t *ret_len) {
  const char *proplet_id =
      g_current_task.proplet_id[0] != '\0' ? g_current_task.proplet_id : "";
  return write_string_to_wasm_memory(exec_env, proplet_id, ret_offset, ret_len);
}

static bool get_model_data_wrapper(wasm_exec_env_t exec_env,
                                   uint32_t *ret_offset, uint32_t *ret_len) {
  const char *model_data =
      g_current_task.model_data_fetched && g_current_task.model_data[0] != '\0'
          ? g_current_task.model_data
          : "";
  return write_string_to_wasm_memory(exec_env, model_data, ret_offset, ret_len);
}

static bool get_dataset_data_wrapper(wasm_exec_env_t exec_env,
                                     uint32_t *ret_offset, uint32_t *ret_len) {
  const char *dataset_data = g_current_task.dataset_data_fetched &&
                                     g_current_task.dataset_data[0] != '\0'
                                 ? g_current_task.dataset_data
                                 : "";
  return write_string_to_wasm_memory(exec_env, dataset_data, ret_offset,
                                     ret_len);
}

static NativeSymbol native_symbols[] = {
    {"get_proplet_id", (void *)get_proplet_id_wrapper, "(~i)", NULL},
    {"get_model_data", (void *)get_model_data_wrapper, "(~i)", NULL},
    {"get_dataset_data", (void *)get_dataset_data_wrapper, "(~i)", NULL},
};

void execute_wasm_module(const char *task_id, const uint8_t *wasm_data,
                         size_t wasm_size, const uint64_t *inputs,
                         size_t inputs_count) {
  maybe_init_wamr_runtime();
  if (!g_wamr_initialized) {
    LOG_ERR("WAMR runtime not available, cannot execute WASM");
    return;
  }

  k_mutex_lock(&g_wasm_apps_mutex, K_FOREVER);

  if (find_app_by_id(task_id) >= 0) {
    LOG_WRN("WASM app with ID %s is already running. Stopping it first...",
            task_id);
    k_mutex_unlock(&g_wasm_apps_mutex);
    stop_wasm_app(task_id);
    k_mutex_lock(&g_wasm_apps_mutex, K_FOREVER);
  }

  int slot = find_free_slot();
  if (slot < 0) {
    LOG_ERR("No free slot to store new WASM app instance (increase "
            "MAX_WASM_APPS).");
    k_mutex_unlock(&g_wasm_apps_mutex);
    return;
  }

  /* Reserve the slot immediately to prevent race conditions */
  g_wasm_apps[slot].in_use = true;
  strncpy(g_wasm_apps[slot].id, task_id, MAX_ID_LEN - 1);
  g_wasm_apps[slot].id[MAX_ID_LEN - 1] = '\0';

  k_mutex_unlock(&g_wasm_apps_mutex);

  bool monitoring_started = false;
  if (task_monitor_start(task_id) == 0) {
    monitoring_started = true;
  } else {
    LOG_WRN("Failed to start task monitoring for %s", task_id);
  }

  char error_buf[128];
  wasm_module_t module =
      wasm_runtime_load(wasm_data, wasm_size, error_buf, sizeof(error_buf));
  if (!module) {
    LOG_ERR("Failed to load WASM module: %s", error_buf);
    if (monitoring_started) {
      task_monitor_stop(task_id);
    }
    extern const char *channel_id;
    extern const char *tenant_id;
    publish_results_with_error(tenant_id, channel_id, task_id, NULL, error_buf);
    /* Release reserved slot */
    k_mutex_lock(&g_wasm_apps_mutex, K_FOREVER);
    g_wasm_apps[slot].in_use = false;
    memset(g_wasm_apps[slot].id, 0, sizeof(g_wasm_apps[slot].id));
    k_mutex_unlock(&g_wasm_apps_mutex);
    return;
  }

  uint32_t n_native_symbols = sizeof(native_symbols) / sizeof(NativeSymbol);
  if (!wasm_runtime_register_natives("env", native_symbols, n_native_symbols)) {
    LOG_WRN("Failed to register native symbols, host functions may not be "
            "available");
  }

  wasm_module_inst_t module_inst =
      wasm_runtime_instantiate(module, 16 * 1024, /* stack size */
                               16 * 1024,         /* heap size */
                               error_buf, sizeof(error_buf));
  if (!module_inst) {
    LOG_ERR("Failed to instantiate WASM module: %s", error_buf);
    if (monitoring_started) {
      task_monitor_stop(task_id);
    }
    wasm_runtime_unload(module);
    extern const char *channel_id;
    extern const char *tenant_id;
    publish_results_with_error(tenant_id, channel_id, task_id, NULL, error_buf);
    /* Release reserved slot */
    k_mutex_lock(&g_wasm_apps_mutex, K_FOREVER);
    g_wasm_apps[slot].in_use = false;
    memset(g_wasm_apps[slot].id, 0, sizeof(g_wasm_apps[slot].id));
    k_mutex_unlock(&g_wasm_apps_mutex);
    return;
  }

  /* Store module handles in the reserved slot */
  k_mutex_lock(&g_wasm_apps_mutex, K_FOREVER);
  g_wasm_apps[slot].module = module;
  g_wasm_apps[slot].module_inst = module_inst;
  k_mutex_unlock(&g_wasm_apps_mutex);

  wasm_function_inst_t func = wasm_runtime_lookup_function(module_inst, "main");
  if (!func) {
    LOG_WRN(
        "Function 'main' not found in WASM module. No entry point to call.");
    if (monitoring_started) {
      task_monitor_stop(task_id);
    }
    wasm_runtime_deinstantiate(module_inst);
    wasm_runtime_unload(module);
    extern const char *channel_id;
    extern const char *tenant_id;
    publish_results_with_error(tenant_id, channel_id, task_id, NULL, error_buf);
    k_mutex_lock(&g_wasm_apps_mutex, K_FOREVER);
    g_wasm_apps[slot].in_use = false;
    memset(g_wasm_apps[slot].id, 0, sizeof(g_wasm_apps[slot].id));
    k_mutex_unlock(&g_wasm_apps_mutex);
    return;
  }

  uint32_t result_count = wasm_func_get_result_count(func, module_inst);
  if (result_count == 0) {
    LOG_ERR("Function has no return value.");
    if (monitoring_started) {
      task_monitor_stop(task_id);
    }
    wasm_runtime_deinstantiate(module_inst);
    wasm_runtime_unload(module);
    extern const char *channel_id;
    extern const char *tenant_id;
    publish_results_with_error(tenant_id, channel_id, task_id, NULL, error_buf);
    k_mutex_lock(&g_wasm_apps_mutex, K_FOREVER);
    g_wasm_apps[slot].in_use = false;
    memset(g_wasm_apps[slot].id, 0, sizeof(g_wasm_apps[slot].id));
    k_mutex_unlock(&g_wasm_apps_mutex);
    return;
  }

  wasm_valkind_t result_types[result_count];
  wasm_func_get_result_types(func, module_inst, result_types);

  g_wasm_apps[slot].in_use = true;
  strncpy(g_wasm_apps[slot].id, task_id, MAX_ID_LEN);
  g_wasm_apps[slot].module = module;
  g_wasm_apps[slot].module_inst = module_inst;

  wasm_val_t results[result_count];
  for (uint32_t i = 0; i < result_count; i++) {
    results[i].kind = result_types[i];
  }

  wasm_val_t args[MAX_INPUTS];
  size_t n_args = (inputs_count > MAX_INPUTS) ? MAX_INPUTS : inputs_count;
  for (size_t i = 0; i < n_args; i++) {
    args[i].kind = WASM_I32;
    args[i].of.i32 = (uint32_t)(inputs[i] & 0xFFFFFFFFu);
  }

  wasm_exec_env_t exec_env =
      wasm_runtime_create_exec_env(module_inst, 16 * 1024);
  if (!exec_env) {

    LOG_ERR("Failed to create execution environment for WASM module.");
    if (monitoring_started) {
      task_monitor_stop(task_id);
    }
    wasm_runtime_deinstantiate(module_inst);
    wasm_runtime_unload(module);
    extern const char *channel_id;
    extern const char *tenant_id;
    publish_results_with_error(tenant_id, channel_id, task_id, NULL, error_buf);
    k_mutex_lock(&g_wasm_apps_mutex, K_FOREVER);
    g_wasm_apps[slot].in_use = false;
    memset(g_wasm_apps[slot].id, 0, sizeof(g_wasm_apps[slot].id));
    k_mutex_unlock(&g_wasm_apps_mutex);
    return;
  }

  if (!wasm_runtime_call_wasm_a(exec_env, func, result_count, results, n_args,
                                args)) {
    const char *exception = wasm_runtime_get_exception(module_inst);
    char error_msg[256];
    snprintf(error_msg, sizeof(error_msg), "WASM execution failed: %s",
             exception ? exception : "Unknown error");
    LOG_ERR("Error invoking WASM function: %s", error_msg);

    extern const char *channel_id;
    extern const char *tenant_id;
    publish_results_with_error(tenant_id, channel_id, task_id, NULL, error_msg);
  } else {
    char results_string[MAX_RESULTS * 16] = {0};

    for (uint32_t i = 0; i < result_count; i++) {
      if (results[i].kind == WASM_I32) {
        char temp[16];
        snprintf(temp, sizeof(temp), "%d", results[i].of.i32);
        strncat(results_string, temp,
                sizeof(results_string) - strlen(results_string) - 1);
        if (i < result_count - 1) {
          strncat(results_string, ",",
                  sizeof(results_string) - strlen(results_string) - 1);
        }
      }
    }

    extern const char *channel_id;
    extern const char *tenant_id;
    publish_results(tenant_id, channel_id, task_id, results_string);
    LOG_INF("WASM execution results published to MQTT topic");
  }

  if (monitoring_started) {
    task_monitor_stop(task_id);
  }

  wasm_runtime_destroy_exec_env(exec_env);
  wasm_runtime_deinstantiate(module_inst);
  wasm_runtime_unload(module);

  /* Release the slot */
  k_mutex_lock(&g_wasm_apps_mutex, K_FOREVER);
  g_wasm_apps[slot].in_use = false;
  memset(g_wasm_apps[slot].id, 0, sizeof(g_wasm_apps[slot].id));
  k_mutex_unlock(&g_wasm_apps_mutex);
}

void stop_wasm_app(const char *task_id) {
  k_mutex_lock(&g_wasm_apps_mutex, K_FOREVER);

  int idx = find_app_by_id(task_id);
  if (idx < 0) {
    LOG_WRN("No running WASM app found with ID=%s", task_id);
    k_mutex_unlock(&g_wasm_apps_mutex);
    return;
  }

  wasm_app_t *app = &g_wasm_apps[idx];
  LOG_INF("Stopping WASM app with ID=%s", app->id);

  /* Stop task monitoring if active (task_monitor has its own mutex) */
  task_monitor_stop(task_id);

  wasm_runtime_deinstantiate(app->module_inst);
  wasm_runtime_unload(app->module);

  app->in_use = false;
  memset(app->id, 0, sizeof(app->id));

  k_mutex_unlock(&g_wasm_apps_mutex);

  LOG_INF("WASM app [%s] has been stopped and unloaded.", task_id);
}

static void maybe_init_wamr_runtime(void) {
  if (g_wamr_initialized) {
    return;
  }

  RuntimeInitArgs init_args;
  memset(&init_args, 0, sizeof(init_args));
  init_args.mem_alloc_type = Alloc_With_System_Allocator;

  if (!wasm_runtime_full_init(&init_args)) {
    LOG_ERR("Failed to initialize WAMR runtime.");
    return;
  }

  g_wamr_initialized = true;
  LOG_INF("WAMR runtime initialized successfully.");
}

static int find_free_slot(void) {
  for (int i = 0; i < MAX_WASM_APPS; i++) {
    if (!g_wasm_apps[i].in_use) {
      return i;
    }
  }
  return -1;
}

static int find_app_by_id(const char *task_id) {
  for (int i = 0; i < MAX_WASM_APPS; i++) {
    if (g_wasm_apps[i].in_use && (strcmp(g_wasm_apps[i].id, task_id) == 0)) {
      return i;
    }
  }
  return -1;
}
```

## src/wifi_manager.c
```c
#include "wifi_manager.h"
#include <zephyr/kernel.h>
#include <zephyr/logging/log.h>
#include <zephyr/net/dhcpv4_server.h>
#include <zephyr/net/net_if.h>
#include <zephyr/net/wifi_mgmt.h>

LOG_MODULE_REGISTER(wifi_manager);

static struct net_if *ap_iface;
static struct net_if *sta_iface;
static struct net_mgmt_event_callback wifi_cb;

#define MACSTR "%02X:%02X:%02X:%02X:%02X:%02X"
#define MAC2STR(mac) mac[0], mac[1], mac[2], mac[3], mac[4], mac[5]

static void wifi_event_handler(struct net_mgmt_event_callback *cb,
                               uint32_t mgmt_event, struct net_if *iface)
{
  switch (mgmt_event)
  {
  case NET_EVENT_WIFI_CONNECT_RESULT:
    LOG_INF("Wi-Fi connected");
    break;
  case NET_EVENT_WIFI_DISCONNECT_RESULT:
    LOG_INF("Wi-Fi disconnected");
    break;
  case NET_EVENT_WIFI_AP_ENABLE_RESULT:
    LOG_INF("AP mode enabled");
    break;
  case NET_EVENT_WIFI_AP_DISABLE_RESULT:
    LOG_INF("AP mode disabled");
    break;
  case NET_EVENT_WIFI_AP_STA_CONNECTED:
  {
    struct wifi_ap_sta_info *sta = (struct wifi_ap_sta_info *)cb->info;
    LOG_INF("Station " MACSTR " connected", MAC2STR(sta->mac));
    break;
  }
  case NET_EVENT_WIFI_AP_STA_DISCONNECTED:
  {
    struct wifi_ap_sta_info *sta = (struct wifi_ap_sta_info *)cb->info;
    LOG_INF("Station " MACSTR " disconnected", MAC2STR(sta->mac));
    break;
  }
  default:
    break;
  }
}

static void enable_dhcpv4_server(const char *ip_address, const char *netmask)
{
  struct in_addr addr, netmask_addr;

  if (net_addr_pton(AF_INET, ip_address, &addr) != 0)
  {
    LOG_ERR("Invalid IP address: %s", ip_address);
    return;
  }

  if (net_addr_pton(AF_INET, netmask, &netmask_addr) != 0)
  {
    LOG_ERR("Invalid netmask: %s", netmask);
    return;
  }

  net_if_ipv4_set_gw(ap_iface, &addr);
  net_if_ipv4_addr_add(ap_iface, &addr, NET_ADDR_MANUAL, 0);
  net_if_ipv4_set_netmask(ap_iface, &netmask_addr);

  addr.s4_addr[3] += 10;
  if (net_dhcpv4_server_start(ap_iface, &addr) != 0)
  {
    LOG_ERR("Failed to start DHCPv4 server");
  }

  LOG_INF("DHCPv4 server started");
}

void wifi_manager_init(void)
{
  net_mgmt_init_event_callback(
      &wifi_cb, wifi_event_handler,
      NET_EVENT_WIFI_CONNECT_RESULT | NET_EVENT_WIFI_DISCONNECT_RESULT |
          NET_EVENT_WIFI_AP_ENABLE_RESULT | NET_EVENT_WIFI_AP_DISABLE_RESULT |
          NET_EVENT_WIFI_AP_STA_CONNECTED | NET_EVENT_WIFI_AP_STA_DISCONNECTED);
  net_mgmt_add_event_callback(&wifi_cb);

  ap_iface = net_if_get_wifi_sap();
  sta_iface = net_if_get_wifi_sta();
}

int wifi_manager_connect(const char *ssid, const char *psk)
{
  if (!sta_iface)
  {
    LOG_ERR("STA interface not initialized");
    return -EIO;
  }

  struct wifi_connect_req_params params = {
      .ssid = ssid,
      .ssid_length = strlen(ssid),
      .psk = psk,
      .psk_length = strlen(psk),
      .security = WIFI_SECURITY_TYPE_PSK,
      .channel = WIFI_CHANNEL_ANY,
      .band = WIFI_FREQ_BAND_UNKNOWN,
  };

  while (1)
  {
    LOG_INF("Connecting to Wi-Fi: %s", ssid);

    int ret = net_mgmt(NET_REQUEST_WIFI_CONNECT, sta_iface,
                       &params, sizeof(params));
    if (ret != 0) {
      LOG_ERR("Connection request failed (%d). Retrying in 5s...", ret);
      k_sleep(K_SECONDS(5));
      continue;
    }

    bool associated = false;
    for (int i = 0; i < 40; i++) {
      k_sleep(K_MSEC(500));
      struct wifi_iface_status status = {0};
      if (net_mgmt(NET_REQUEST_WIFI_IFACE_STATUS, sta_iface,
                   &status, sizeof(status)) == 0) {
        if (status.state >= WIFI_STATE_COMPLETED) {
          associated = true;
          break;
        }
      }
    }

    if (associated) {
      k_sleep(K_SECONDS(5));
      LOG_INF("Connected to Wi-Fi: %s", ssid);
      return 0;
    }

    LOG_WRN("Wi-Fi connect timed out. Retrying...");
    net_mgmt(NET_REQUEST_WIFI_DISCONNECT, sta_iface, NULL, 0);
    k_sleep(K_SECONDS(3));
  }
}

int wifi_manager_enable_ap(const char *ssid, const char *psk,
                           const char *ip_address, const char *netmask)
{
  if (!ap_iface)
  {
    LOG_ERR("AP interface not initialized");
    return -EIO;
  }

  struct wifi_connect_req_params params = {
      .ssid = ssid,
      .ssid_length = strlen(ssid),
      .psk = psk,
      .psk_length = strlen(psk),
      .security =
          (strlen(psk) > 0) ? WIFI_SECURITY_TYPE_PSK : WIFI_SECURITY_TYPE_NONE,
      .channel = WIFI_CHANNEL_ANY,
      .band = WIFI_FREQ_BAND_2_4_GHZ,
  };

  enable_dhcpv4_server(ip_address, netmask);

  LOG_INF("Enabling AP mode with SSID: %s", ssid);
  return net_mgmt(NET_REQUEST_WIFI_AP_ENABLE, ap_iface, &params,
                  sizeof(params));
}
```
